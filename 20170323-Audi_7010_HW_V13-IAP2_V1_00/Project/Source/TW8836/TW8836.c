#define __TW8836_C__


//#include "kernel.h"
//#include "sI2C.h"
#include "SPIFlash.h"
#include "TW8836.h"
#include "i2c_driver.h"
#include "libr.h"
#include "Menu.h"
#include "OSDFont.h"
#if 0//miller.tao20150829
const uint8_t TW8836_REG_TAB[] =
{
    0xFF, 0x00,  // Page 00
    0x02, 0x49,
    0x03, 0xFF,
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    0xFF, 0xFF,
};
#else
const uint8_t TW8836_REG_TAB[] =
{
	0xFF,0x00,	//; Page 00
	0x02,0x6B,
	0x03,0xFF,
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        0xff,0xff,
};
#endif

 void TW8836_Configuration( void )
{
    uint16_t i = 0;

    for(i = 0; i < sizeof(TW8836_REG_TAB); i+=2)
    {
        TW8836_Write(TW8836_REG_TAB[i], TW8836_REG_TAB[i+1]);
    }

    //printf("\r\nTW8836 Configuration Finished.");
}


void InitTW8836( void )
{
    //sI2cInit();

    TW8836_WritePage(0x00);

   // printf("\r\nTW88xx ID = %x , REV = %x", TW8836_Read(REG000), TW8836_Read(REG001));

    SpiFlashInit();

    //TW8836_Configuration(); 
	Delay_1ms(20 * 10);
}


uint8_t TW8836_Read( uint8_t suba )
{
    //return sI2cReadByte(0x8A, suba);
    return ReadTW88(suba);
}


void TW8836_Write( uint8_t suba, uint8_t dat )
{
    //sI2cWriteByte(0x8A, suba, dat);
    WriteTW88(suba,dat);
}


void TW8836_WritePage( uint8_t dat )
{
    //sI2cWriteByte(0x8A, 0xFF, dat);
    WriteTW88(0xff,dat);
}


void TW8836_WaitVBlank( uint8_t cnt )
{
    uint8_t  i = 0;
    uint16_t j = 0;

    TW8836_WritePage(TW8836_PAGE0_GENERAL);

    for(i = 0; i < cnt; i++)
    {
        TW8836_Write(REG002, 0xFF);

        j = 0;

        while(!(TW8836_Read(REG002) & 0x40))
        {
            j++;

            if(j > TW8836_WAIT_VBLANK_VALUE)
            {
                //printf("\r\nError : Wait VBlank.");
                break;
            }
        }
    }
}

void Init_FontOSD(void)
{
//	BackLight(1); //test
	FontOsdInit();
//	FOsdSetDeValue();
//	TestNum1BPP3BPP();
//	Delay_1ms(100);
//	FOsdIndexMsgPrint(FOSD_STR1_TW8836);

//	FOsdWinEnable(0, OFF);	//win0, disable..
}

void FOsdDisableAllWin(void)
{
	uint8_t i;
	for(i = 0;i<FOSD_MAX_OSDWIN; i++)
	{
		FOsdWinEnable(i, OFF);
	}
}


void OuputVideoEnable(uint8_t en)
{
	TW8836_WritePage(TW8836_PAGE2_TCON);
	if(en)
	{
		TW8836_Write(REG21E, (TW8836_Read(REG21E) & 0xfe));
	}
	else
	{
		TW8836_Write(REG21E, (TW8836_Read(REG21E) | 0x01));
	}
}


